## boards/chalukas/eyelash_corne/board.yml
```yaml
boards:
  - name: eyelash_corne_left
    vendor: chalukas
    socs:
      - name: nrf52840
        variants:
          - name: zmk
  - name: eyelash_corne_right
    vendor: chalukas
    socs:
      - name: nrf52840
        variants:
          - name: zmk
```

## config/west.yml
```yaml
manifest:
  remotes:
    - name: zmkfirmware
      url-base: https://github.com/zmkfirmware
      # Additional modules containing boards/shields/custom code can be listed here as well.
      # See:
      # - https://zmk.dev/docs/features/modules
      # - https://docs.zephyrproject.org/latest/develop/west/manifest.html#projects
    - name: urob
      url-base: https://github.com/urob
  projects:
    - name: zmk
      remote: zmkfirmware
      revision: faaf39d9f59cd2a27eca3739cdd9eb197654299b
      import: app/west.yml
    - name: zmk-helpers
      remote: urob
      revision: bc114546392b4615ac90a99140eaf21dde31209d
  self:
    path: config
```
